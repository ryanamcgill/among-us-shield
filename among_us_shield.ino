#include <Vector.h>
#include <Adafruit_TFTLCD.h> 
#include <Adafruit_GFX.h>    
#include <TouchScreen.h>

#define LCD_CS A3 
#define LCD_CD A2 
#define LCD_WR A1 
#define LCD_RD A0 
#define LCD_RESET A4 

#define TS_MINX 120
#define TS_MAXX 900
#define TS_MINY 70
#define TS_MAXY 920

#define YP A2  
#define XM A3  
#define YM 8  
#define XP 9  

#define BLACK   0x0000
#define BLUE    0x001F
#define RED     0xF800
#define GREEN   0x07E0
#define CYAN    0x07FF
#define MAGENTA 0xF81F
#define YELLOW  0xFFE0
#define WHITE   0xFFFF
#define ORANGE  0xA233
#define LT_GRAY 0xC618
#define DK_GRAY 0x7BEF
#define GRAY    0x7BEF

#define TALK_W  10

#define SCREEN_H    240
#define SCREEN_W    320

#define HEAD_OFFS_X  10 


#define TALK_H  40
#define TALK_O  5
#define TALK_R1 10
#define TALK_R2 57
#define TALK_R3 104
#define TALK_BEGIN  53

#define TEXT_O  17
#define HEAD_O  10

#define BUTTON_Y   154
#define BUTTON_X1   85
#define BUTTON_X2  165
#define BUTTON_H    70

#define DEATH_CHAT_X1  50
#define DEATH_CHAT_Y  100

#define NUM_STARS  31
#define DIAM_LIM    3
#define DEAD_DELAY 10000

const int NUM_SAYINGS = 7;
const int MAX_SIZE    = 22;
const int NUM_COLORS  = 5;


char sayings [NUM_SAYINGS][MAX_SIZE]{
  "yo ryan sus bro",
  "I watched white vent",
  "Ryan killed on cams",
  "where was white?",
  "ryan was in nav",
  "white faked tasks",
  "ryan sus"
};

int sayings_inds [NUM_SAYINGS] {
  0,1,2,3,4,5,6
};


uint32_t colors[] {
  RED,
  YELLOW,
  CYAN,
  GREEN,
  BLUE
};

//Setup TFT shield and touchscreen
Adafruit_TFTLCD tft(LCD_CS, LCD_CD, LCD_WR, LCD_RD, LCD_RESET);
TouchScreen ts = TouchScreen(XP, YP, XM, YM, 300);


/**
 * Draws setup board and buttons
 */
void setup() {
  Serial.begin(9600);
  randomSeed(analogRead(0));
  tft.reset(); 
  tft.begin(0x9341);
  tft.setRotation(1);
  main_screen();
}


void loop() {
  TSPoint p = ts.getPoint(); 
  
  if (p.z > ts.pressureThreshhold) {
    // A touch is detected
    p.x = map(p.x, TS_MAXX, TS_MINX, 0, 320);
    p.y = map(p.y, TS_MAXY, TS_MINY, 0, 240);
       
    
    pinMode(XM, OUTPUT);
    pinMode(YP, OUTPUT);
    if (p.x > (BUTTON_X1) && p.x < (BUTTON_X1+BUTTON_H) &&
        p.y > (10) && p.y < (80)) {
      // Yes was pressed
      dead_screen(false);
      tft.setTextColor(WHITE);
      tft.setTextSize(2);
      tft.setCursor(70,100);
      tft.print("Ryan");
      //tft.drawChar(90,100,'w',WHITE,0,2);
      delay(DEAD_DELAY);
      main_screen();
    }
    if (p.x > BUTTON_X2 && p.x < (BUTTON_X2+BUTTON_H) &&
        p.y > 10 && p.y < (80)) {
      // No was pressed
      dead_screen(true);
      tft.setTextColor(WHITE);
      tft.setTextSize(2);
      tft.setCursor(70,100);
      tft.print("Ryan");
      delay(DEAD_DELAY);
      main_screen();
    }
      

    delay(10);  
  }
}

void main_screen() {
  // Randomize sayings, colors
  //randomize();
  const int cnt = 5;
  for (int i=0; i < cnt; i++) {
    int n = random(0,cnt);
    uint32_t temp = colors[n];
    colors[n] = colors[i];
    colors[i] = temp;
  }
  int i0 = sayings_inds[0];
  int i1 = sayings_inds[1];
  int i2 = sayings_inds[2];
  tft.fillScreen(BLACK); // Background screen
  tft.fillRect(TALK_O,TALK_R1,SCREEN_W-25,TALK_H,WHITE);
  tft.setCursor(TALK_BEGIN,TALK_R1+TEXT_O);
  tft.setTextColor(BLACK); // Text color
  tft.setTextSize(2);
  tft.print("ryan sus"); // Text above the button
  draw_head(HEAD_OFFS_X,HEAD_O+TALK_R1, colors[0]);
  //delay(1000);

  tft.fillRect(TALK_O,TALK_R2,SCREEN_W-25,TALK_H,WHITE);
  tft.setCursor(TALK_BEGIN,TALK_R2+TEXT_O);
  tft.print("I saw him vent");
  draw_head(HEAD_OFFS_X,HEAD_O+TALK_R2, colors[1]);
  //delay(1000);

  tft.fillRect(TALK_O,TALK_R3,SCREEN_W-25,TALK_H,WHITE);
  tft.setCursor(TALK_BEGIN,TALK_R3+TEXT_O);
  tft.print("Ryan killed on cams");
  draw_head(HEAD_OFFS_X,HEAD_O+TALK_R3, colors[2]);
  //delay(1000);
  // Draw buttons
  tft.fillRect(BUTTON_X1,BUTTON_Y,BUTTON_H,BUTTON_H,WHITE);
  tft.fillRect(BUTTON_X2,BUTTON_Y,BUTTON_H,BUTTON_H,WHITE);

  draw_mark1(BUTTON_X1,BUTTON_Y);
  draw_mark2(BUTTON_X2,BUTTON_Y);
  draw_mark3(BUTTON_X2,BUTTON_Y);
}

void randomize() {


  // Is there a better way? Yes. Will I change it? No.
  /*
  const int cnt2 = sizeof(sayings_inds) / sizeof(sayings_inds[0]);
  for (int j = 0; j < cnt2; j++) {
    int r = random(0,cnt2); 
    int temp;
    temp = sayings_inds[j];
    sayings_inds[j] = sayings_inds[r];
    sayings_inds[r] = temp;
  }*/
}

void draw_head(uint16_t x, uint16_t y, uint32_t color_in) {
  // Draw row by row
  boolean black_mat[16][16] = 
  {
    {0, 0, 0, 0, 0, 0, 1, 1, 1, 1, 1, 1, 0, 0, 0, 0},
    {0, 0, 0, 0, 0, 1, 0, 0, 0, 0, 0, 0, 1, 0, 0, 0},
    {0, 0, 0, 0, 1, 0, 0, 0, 0, 0, 0, 0, 0, 1, 0, 0},
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    {0, 0, 0, 0, 0, 0, 0, 0, 0, 0, 0, 0, 0, 0, 0, 0},
  };
  boolean gray_mat[16][16] = 
  {
    {0, 0, 0, 0, 0, 0, 0, 0, 0, 0, 0, 0, 0, 0, 0, 0},
    {0, 0, 0, 0, 0, 0, 0, 0, 0, 0, 0, 0, 0, 0, 0, 0},
    {0, 0, 0, 0, 0, 0, 0, 0, 0, 0, 0, 0, 0, 0, 0, 0},
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    {0, 0, 0, 0, 0, 0, 0, 0, 0, 0, 0, 0, 0, 0, 0, 0},
  };
  boolean dark_gray_mat[16][16] = 
  {
    {0, 0, 0, 0, 0, 0, 0, 0, 0, 0, 0, 0, 0, 0, 0, 0},
    {0, 0, 0, 0, 0, 0, 0, 0, 0, 0, 0, 0, 0, 0, 0, 0},
    {0, 0, 0, 0, 0, 0, 0, 0, 0, 0, 0, 0, 0, 0, 0, 0},
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    {0, 0, 0, 0, 0, 0, 0, 0, 0, 0, 0, 0, 0, 0, 0, 0},
  };
  boolean light_gray_mat[16][16] = 
  {
    {0, 0, 0, 0, 0, 0, 0, 0, 0, 0, 0, 0, 0, 0, 0, 0},
    {0, 0, 0, 0, 0, 0, 0, 0, 0, 0, 0, 0, 0, 0, 0, 0},
    {0, 0, 0, 0, 0, 0, 0, 0, 0, 0, 0, 0, 0, 0, 0, 0},
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    {0, 0, 0, 0, 0, 0, 0, 0, 0, 0, 0, 0, 0, 0, 0, 0},
  };
  boolean diff_mat[16][16] = 
  {
    {0, 0, 0, 0, 0, 0, 0, 0, 0, 0, 0, 0, 0, 0, 0, 0},
    {0, 0, 0, 0, 0, 0, 1, 1, 0, 0, 0, 0, 0, 0, 0, 0},
    {0, 0, 0, 0, 0, 1, 1, 1, 0, 0, 0, 0, 0, 0, 0, 0},
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    {0, 0, 0, 0, 0, 0, 0, 0, 0, 0, 0, 0, 0, 0, 0, 0},
  };
  boolean diff_mat_t[3][16] = 
  {
    {0, 0, 0, 0, 0, 0, 0, 0, 0, 0, 0, 0, 0, 0, 0, 0},
    {0, 0, 0, 0, 0, 0, 0, 0, 1, 1, 1, 1, 0, 0, 0, 0},
    {0, 0, 0, 0, 0, 0, 0, 0, 1, 1, 1, 1, 1, 0, 0, 0},
  };

  int16_t e_row = 0;
  for (int16_t row=0;row<16;row++) {
    int16_t e_col = 0;
    for (int16_t col=0; col<16; col++) {
      if (black_mat[col][row]) {
        tft.drawPixel(x+e_row,y+e_col,BLACK);
        tft.drawPixel(x+e_row+1,y+e_col,BLACK);
        tft.drawPixel(x+e_row+1,y+e_col+1,BLACK);
        tft.drawPixel(x+e_row,y+e_col+1,BLACK);       
      } else if (gray_mat[col][row]) {
        tft.drawPixel(x+e_row,y+e_col,LT_GRAY);
        tft.drawPixel(x+e_row+1,y+e_col,LT_GRAY);
        tft.drawPixel(x+e_row+1,y+e_col+1,LT_GRAY);
        tft.drawPixel(x+e_row,y+e_col+1,LT_GRAY);       
      } /*else if (light_gray_mat[col][row]) {
        tft.drawPixel(x+e_row,y+e_col,LT_GRAY);
        tft.drawPixel(x+e_row+1,y+e_col,LT_GRAY);
        tft.drawPixel(x+e_row+1,y+e_col+1,LT_GRAY);
        tft.drawPixel(x+e_row,y+e_col+1,LT_GRAY);       
      }*/ else if (dark_gray_mat[col][row]) {
        tft.drawPixel(x+e_row,y+e_col,DK_GRAY);
        tft.drawPixel(x+e_row+1,y+e_col,DK_GRAY);
        tft.drawPixel(x+e_row+1,y+e_col+1,DK_GRAY);
        tft.drawPixel(x+e_row,y+e_col+1,DK_GRAY);       
      } else if (diff_mat[col][row]) {
        tft.drawPixel(x+e_row,y+e_col,color_in);
        tft.drawPixel(x+e_row+1,y+e_col,color_in);
        tft.drawPixel(x+e_row+1,y+e_col+1,color_in);
        tft.drawPixel(x+e_row,y+e_col+1,color_in);       
      }
      e_col = e_col +2;
    }
    e_row = e_row+2;
  }

  e_row = 0;
  for (int16_t row=0;row<16;row++) {
    int16_t e_col = 0;
    for (int16_t col=0; col<3; col++) {
      if (diff_mat_t[col][row]) {
        tft.drawPixel(x+e_row,y+e_col,color_in);
        tft.drawPixel(x+e_row+1,y+e_col,color_in);
        tft.drawPixel(x+e_row+1,y+e_col+1,color_in);
        tft.drawPixel(x+e_row,y+e_col+1,color_in);       
      }
      e_col = e_col +2;
    }
    e_row = e_row+2;
  }
}

void draw_mark1(uint16_t x, uint16_t y) {
  boolean checkmark[35][35] = 
  {
    {0, 0, 0, 0, 0, 0, 0, 0, 0, 0, 0, 0, 0, 0, 0, 0, 0, 0, 0, 0, 0, 0, 0, 0, 0, 0, 0, 0, 0, 0, 0, 0, 0, 0, 0},
    {0, 0, 0, 0, 0, 0, 0, 0, 0, 0, 0, 0, 0, 0, 0, 0, 0, 0, 0, 0, 0, 0, 0, 0, 0, 0, 0, 0, 0, 0, 0, 0, 0, 0, 0},
    {0, 0, 0, 0, 0, 0, 0, 0, 0, 0, 0, 0, 0, 0, 0, 0, 0, 0, 0, 0, 0, 0, 0, 0, 0, 0, 0, 0, 0, 0, 0, 0, 0, 0, 0},
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    {0, 0, 0, 0, 0, 0, 0, 0, 0, 0, 0, 0, 0, 0, 0, 0, 0, 0, 0, 0, 0, 0, 0, 0, 0, 0, 0, 0, 0, 0, 0, 0, 0, 0, 0},
  };
  int16_t e_row = 0;
  for (int16_t row=0;row<35;row++) {
    int16_t e_col = 0;
    for (int16_t col=0; col<35; col++) {
      if (checkmark[col][row]) {
        tft.drawPixel(x+e_row,y+e_col,GREEN);
        tft.drawPixel(x+e_row+1,y+e_col,GREEN);
        tft.drawPixel(x+e_row+1,y+e_col+1,GREEN);
        tft.drawPixel(x+e_row,y+e_col+1,GREEN);       
      }
      e_col = e_col +2;
    }
    e_row = e_row+2;
  }

}

void draw_mark2(uint16_t x, uint16_t y) {

  boolean cross[35][35] = 
  {
    {0, 0, 0, 0, 0, 0, 0, 0, 0, 0, 0, 0, 0, 0, 0, 0, 0, 0, 0, 0, 0, 0, 0, 0, 0, 0, 0, 0, 0, 0, 0, 0, 0, 0, 0},
    {0, 0, 0, 0, 0, 0, 0, 0, 0, 0, 0, 0, 0, 0, 0, 0, 0, 0, 0, 0, 0, 0, 0, 0, 0, 0, 0, 0, 0, 0, 0, 0, 0, 0, 0},
    {0, 0, 0, 0, 0, 0, 0, 0, 0, 0, 0, 0, 0, 0, 0, 0, 0, 0, 0, 0, 0, 0, 0, 0, 0, 0, 0, 0, 0, 0, 0, 0, 0, 0, 0},
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    {0, 0, 0, 0, 0, 0, 0, 0, 0, 0, 0, 0, 0, 0, 0, 0, 0, 0, 0, 0, 0, 0, 0, 0, 0, 0, 0, 0, 0, 0, 0, 0, 0, 0, 0},
  };

  int16_t e_row = 0;
  for (int16_t row=0;row<35;row++) {
    int16_t e_col = 0;
    for (int16_t col=0; col<35; col++) {
      if (cross[col][row]) {
        tft.drawPixel(x+e_row,y+e_col,RED);
        tft.drawPixel(x+e_row+1,y+e_col,RED);
        tft.drawPixel(x+e_row+1,y+e_col+1,RED);
        tft.drawPixel(x+e_row,y+e_col+1,RED);       
      }
      e_col = e_col +2;
    }
    e_row = e_row+2;
  }

  
}

void draw_mark3(uint16_t x, uint16_t y) {
  boolean top[14][35] = 
  {
    {0, 0, 0, 0, 0, 0, 0, 0, 0, 0, 0, 0, 0, 0, 0, 0, 0, 0, 0, 0, 0, 0, 0, 0, 0, 0, 0, 0, 0, 0, 0, 0, 0, 0, 0},
    {0, 0, 0, 0, 0, 0, 0, 0, 0, 0, 0, 0, 0, 0, 0, 0, 0, 0, 0, 0, 0, 0, 0, 0, 0, 0, 0, 0, 0, 0, 0, 0, 0, 0, 0},
    {0, 0, 0, 0, 0, 0, 0, 0, 0, 0, 0, 0, 0, 0, 0, 0, 0, 0, 0, 0, 0, 0, 0, 0, 0, 0, 0, 0, 0, 0, 0, 0, 0, 0, 0},
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    {0, 0, 0, 0, 0, 0, 0, 1, 1, 1, 1, 1, 1, 1, 1, 1, 1, 1, 1, 1, 1, 1, 1, 1, 1, 0, 0, 0, 0, 0, 0, 0, 0, 0, 0},
  };

  int16_t e_row = 0;
  for (int16_t row=0;row<35;row++) {
    int16_t e_col = 0;
    for (int16_t col=0; col<14; col++) {
      if (top[col][row]) {
        tft.drawPixel(x+e_row,y+e_col,RED);
        tft.drawPixel(x+e_row+1,y+e_col,RED);
        tft.drawPixel(x+e_row+1,y+e_col+1,RED);
        tft.drawPixel(x+e_row,y+e_col+1,RED);       
      }
      e_col = e_col +2;
    }
    e_row = e_row+2;
  }
}

void dead_screen(boolean box_press) {
  tft.fillScreen(BLACK); // Background screen
  // Get random coords and diamaters
  for (int16_t i = 0; i<NUM_STARS; i++) {
    int16_t x = random(SCREEN_W);
    int16_t y = random(SCREEN_H);
    int16_t diam = random(DIAM_LIM)+1;
    tft.fillCircle(x, y, diam, WHITE);
  }
  

}